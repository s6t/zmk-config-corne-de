## config/west.yml
```yaml
manifest:
  remotes:
    - name: zmkfirmware
      url-base: https://github.com/zmkfirmware
    - name: s6t
      url-base: https://github.com/s6t
  projects:
    - name: zmk
      remote: zmkfirmware
      revision: main
      import: app/west.yml
    - name: zmk-shield-nice-view-cats
      remote: s6t
      revision: main
      path: config/boards/shields/nice_view_cats
  self:
    path: config
```
